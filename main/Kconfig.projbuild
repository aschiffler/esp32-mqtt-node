## main/Kconfig.projbuild
```kconfig
menu "MQTT Configuration"

    config BROKER_BIN_SIZE_TO_SEND
        # This option is not visible and is used only to set parameters for example tests
        # Here we configure the data size to send and to be expected in the python script
        int
        default 20000
    config USER_INPUT_LENGTH
        int
        default 128

endmenu
```
